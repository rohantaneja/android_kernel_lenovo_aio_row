## drivers/misc/mediatek/leds/Kconfig
```kconfig
config MTK_LEDS
	tristate "MediaTek LED Support"
	depends on LEDS_CLASS
	---help---
	  This selects the MediaTek(R) LEDs connected to MediaTek chips.
	  If you want to use MediaTek(R) LEDs support, say Y or M here.
	  If unsure, say N.

config LIGHTNESS_MAPPING_VALUE
	int "LIGHTNESS_MAPPING_VALUE"
	default 255
 	---help---
	  Backlight brightness mapping value, from 0 to 255.

config MTK_CUST_LEDS
	tristate "LED Notification"
        default n
	---help---
	  Say Y here to get LED notications other than VIBE based ROMs.
```

## drivers/misc/mediatek/mach/mt6752/aio_row/leds/mt6752/Kconfig
```kconfig
config MTK_CUST_LEDS
	tristate "LED Notification"
        default n
	help
	  Say Y here to get LED notications other than VIBE based ROMs.
```
